## layers/meta-sixlinux/conf/layer.conf
```bitbake
BBPATH .= ":${LAYERDIR}"

BBFILES += "${LAYERDIR}/recipes-*/*/*.bb \
            ${LAYERDIR}/recipes-*/*/*.bbappend"
BBFILES += "${LAYERDIR}/recipes-core/images/sixlinux-image-minimal.bb"
BBFILES += "${LAYERDIR}/recipes-kernel/sixlinux-rtc-driver_1.0.bb"

BBFILE_COLLECTIONS += "sixlinux"
BBFILE_PATTERN_sixlinux = "^${LAYERDIR}/"
BBFILE_PRIORITY_sixlinux = "6"

LAYERSERIES_COMPAT_sixlinux = "scarthgap"
```
